## ARM64-RTOS/Kconfig
```kconfig
#
# Gracemont Industrial Control Framework - ARM64 RTOS
# Copyright (C) 2024 Zixiao System <https://github.com/Zixiao-System>
#
# SPDX-License-Identifier: GPL-3.0-or-later
#
# Main Kconfig
#

mainmenu "Gracemont ARM64 RTOS Configuration"

config GRACEMONT_RTOS
	bool
	default y

menu "System Configuration"

config CPU_FREQ_HZ
	int "CPU Frequency (Hz)"
	default 1000000000
	help
	  The CPU clock frequency in Hz.
	  Default is 1 GHz (1000000000).

config TICK_RATE_HZ
	int "System Tick Rate (Hz)"
	range 100 10000
	default 1000
	help
	  System tick frequency in Hz.
	  Higher values provide finer timing granularity but increase overhead.
	  Default is 1000 Hz (1ms tick).

config MAX_TASKS
	int "Maximum Number of Tasks"
	range 4 256
	default 32
	help
	  Maximum number of concurrent tasks supported.

config MAX_PRIORITY
	int "Maximum Priority Levels"
	range 4 256
	default 16
	help
	  Number of priority levels (0 = highest priority).

config TASK_STACK_SIZE
	int "Default Task Stack Size (bytes)"
	range 1024 65536
	default 4096
	help
	  Default stack size for tasks in bytes.

config IDLE_STACK_SIZE
	int "Idle Task Stack Size (bytes)"
	range 512 8192
	default 1024
	help
	  Stack size for the idle task.

endmenu

menu "Memory Configuration"

config HEAP_SIZE
	int "Heap Size (bytes)"
	range 65536 268435456
	default 16777216
	help
	  Total heap memory size in bytes.
	  Default is 16 MB.

config DMA_POOL_SIZE
	int "DMA Pool Size (bytes)"
	range 65536 67108864
	default 4194304
	help
	  DMA-capable memory pool size for zero-copy operations.
	  Default is 4 MB.

config ZBUF_POOL_SIZE
	int "Zero-Copy Buffer Pool Size (bytes)"
	range 65536 16777216
	default 2097152
	help
	  Memory pool for zero-copy network buffers.
	  Default is 2 MB.

config ZBUF_COUNT
	int "Number of Zero-Copy Buffers"
	range 64 8192
	default 1024
	help
	  Number of pre-allocated zero-copy buffers.

config ZBUF_SIZE
	int "Zero-Copy Buffer Size (bytes)"
	range 256 65536
	default 2048
	help
	  Size of each zero-copy buffer (should accommodate MTU + headers).

config ZBUF_HEADROOM
	int "Zero-Copy Buffer Headroom (bytes)"
	range 32 512
	default 128
	help
	  Reserved space at the start of each buffer for protocol headers.

endmenu

source "kernel/Kconfig"
source "drivers/Kconfig"
source "net/Kconfig"
source "protocols/Kconfig"
source "arch/arm64/Kconfig"

menu "Debug Configuration"

config DEBUG_UART
	bool "Enable Debug UART Output"
	default y
	help
	  Enable debug messages via UART.

config DEBUG_LEVEL
	int "Debug Level"
	range 0 3
	default 2
	depends on DEBUG_UART
	help
	  Debug verbosity level:
	    0 = None
	    1 = Errors only
	    2 = Warnings and errors
	    3 = Info, warnings, and errors

config BUILD_TESTS
	bool "Build Unit Tests"
	default n
	help
	  Include unit tests in the build.

endmenu
```

## ARM64-RTOS/arch/arm64/Kconfig
```kconfig
#
# ARM64 Architecture Configuration
#

menu "ARM64 Architecture"

config ARM64_CPU
	string "Target CPU"
	default "cortex-a53"
	help
	  Target ARM64 CPU type for optimization.
	  Examples: cortex-a53, cortex-a57, cortex-a72

menu "GIC (Generic Interrupt Controller)"

config GICD_BASE
	hex "GIC Distributor Base Address"
	default 0x08000000
	help
	  Base address of the GIC Distributor.

config GICC_BASE
	hex "GIC CPU Interface Base Address"
	default 0x08010000
	help
	  Base address of the GIC CPU Interface.

config GIC_SPI_START
	int "SPI Interrupt Start Number"
	default 32
	help
	  Starting interrupt number for Shared Peripheral Interrupts.

endmenu

menu "MMU Configuration"

config MMU_ENABLED
	bool "Enable MMU"
	default y
	help
	  Enable the Memory Management Unit.

config MMU_PAGE_SIZE
	int "Page Size (bytes)"
	default 4096
	depends on MMU_ENABLED
	help
	  Virtual memory page size.

config DCACHE_ENABLED
	bool "Enable Data Cache"
	default y
	depends on MMU_ENABLED
	help
	  Enable the data cache.

config ICACHE_ENABLED
	bool "Enable Instruction Cache"
	default y
	depends on MMU_ENABLED
	help
	  Enable the instruction cache.

endmenu

endmenu
```

## ARM64-RTOS/configs/defconfig
```kconfig
#
# Gracemont ARM64 RTOS Default Configuration
#
# This is the default configuration for QEMU virt machine
#

# System Configuration
CONFIG_CPU_FREQ_HZ=1000000000
CONFIG_TICK_RATE_HZ=1000
CONFIG_MAX_TASKS=32
CONFIG_MAX_PRIORITY=16
CONFIG_TASK_STACK_SIZE=4096
CONFIG_IDLE_STACK_SIZE=1024

# Memory Configuration
CONFIG_HEAP_SIZE=16777216
CONFIG_DMA_POOL_SIZE=4194304
CONFIG_ZBUF_POOL_SIZE=2097152
CONFIG_ZBUF_COUNT=1024
CONFIG_ZBUF_SIZE=2048
CONFIG_ZBUF_HEADROOM=128

# Kernel Configuration
CONFIG_KERNEL_PREEMPTION=y
CONFIG_KERNEL_TIMESLICE=10
# CONFIG_KERNEL_STATS is not set
CONFIG_KERNEL_STACK_CHECK=y
CONFIG_KERNEL_IDLE_SLEEP=y

# ARM64 Architecture
CONFIG_ARM64_CPU="cortex-a53"
CONFIG_GICD_BASE=0x08000000
CONFIG_GICC_BASE=0x08010000
CONFIG_GIC_SPI_START=32
CONFIG_MMU_ENABLED=y
CONFIG_MMU_PAGE_SIZE=4096
CONFIG_DCACHE_ENABLED=y
CONFIG_ICACHE_ENABLED=y

# UART Configuration
CONFIG_UART_ENABLED=y
CONFIG_UART_BASE=0x09000000
CONFIG_UART_IRQ=33
CONFIG_UART_COUNT=1
CONFIG_UART_CLOCK=24000000
CONFIG_UART_BAUD_DEFAULT=115200

# Ethernet Configuration
CONFIG_ETH_ENABLED=y
CONFIG_ETH_BASE=0x0A000000
CONFIG_ETH_IRQ=47
CONFIG_ETH_RX_DESCRIPTORS=256
CONFIG_ETH_TX_DESCRIPTORS=256

# Timer Configuration
CONFIG_TIMER_ENABLED=y
CONFIG_TIMER_IRQ=27

# Network Stack
CONFIG_NET_ENABLED=y
CONFIG_NET_RX_RING_SIZE=256
CONFIG_NET_TX_RING_SIZE=256
CONFIG_NET_MAX_SOCKETS=64
CONFIG_TCP_ENABLED=y
CONFIG_TCP_MSS=1460
CONFIG_TCP_WINDOW_SIZE=65535
CONFIG_TCP_MAX_CONNECTIONS=64
CONFIG_TCP_RETRIES=5
CONFIG_UDP_ENABLED=y

# Modbus Configuration
CONFIG_MODBUS_ENABLED=y
CONFIG_MODBUS_TCP=y
CONFIG_MODBUS_TCP_PORT=502
CONFIG_MODBUS_RTU=y
CONFIG_MODBUS_RTU_BAUD=115200
CONFIG_MODBUS_MAX_REGS=256
CONFIG_MODBUS_MAX_COILS=2048
CONFIG_MODBUS_SLAVE_ADDR=1

# OPC UA Configuration
CONFIG_OPCUA_ENABLED=y
CONFIG_OPCUA_PORT=4840
CONFIG_OPCUA_MAX_SESSIONS=8
CONFIG_OPCUA_MAX_SUBSCRIPTIONS=16
CONFIG_OPCUA_MAX_NODES=1024
CONFIG_OPCUA_SECURITY_NONE=y
# CONFIG_OPCUA_SECURITY_SIGN is not set
# CONFIG_OPCUA_SECURITY_ENCRYPT is not set

# PROFINET Configuration
CONFIG_PROFINET_ENABLED=y
CONFIG_PROFINET_CYCLE_TIME=1000
CONFIG_PROFINET_MAX_DEVICES=32
CONFIG_PROFINET_MAX_SLOTS=16
CONFIG_PROFINET_MAX_SUBSLOTS=8
CONFIG_PROFINET_RT_CLASS=1

# Debug Configuration
CONFIG_DEBUG_UART=y
CONFIG_DEBUG_LEVEL=2
# CONFIG_BUILD_TESTS is not set
```

## ARM64-RTOS/drivers/Kconfig
```kconfig
#
# Driver Configuration
#

menu "Device Drivers"

menu "UART Configuration"

config UART_ENABLED
	bool "Enable UART Driver"
	default y
	help
	  Enable the PL011 UART driver.

config UART_BASE
	hex "UART Base Address"
	default 0x09000000
	depends on UART_ENABLED
	help
	  Base address of the UART peripheral.

config UART_IRQ
	int "UART IRQ Number"
	default 33
	depends on UART_ENABLED
	help
	  IRQ number for UART interrupts.

config UART_COUNT
	int "Number of UART Ports"
	range 1 4
	default 1
	depends on UART_ENABLED
	help
	  Number of UART ports to enable.

config UART_CLOCK
	int "UART Clock Frequency (Hz)"
	default 24000000
	depends on UART_ENABLED
	help
	  UART peripheral clock frequency in Hz.

config UART_BAUD_DEFAULT
	int "Default Baud Rate"
	default 115200
	depends on UART_ENABLED
	help
	  Default UART baud rate.

endmenu

menu "Ethernet Configuration"

config ETH_ENABLED
	bool "Enable Ethernet Driver"
	default y
	help
	  Enable the Ethernet MAC driver.

config ETH_BASE
	hex "Ethernet Base Address"
	default 0x0A000000
	depends on ETH_ENABLED
	help
	  Base address of the Ethernet MAC.

config ETH_IRQ
	int "Ethernet IRQ Number"
	default 47
	depends on ETH_ENABLED
	help
	  IRQ number for Ethernet interrupts.

config ETH_RX_DESCRIPTORS
	int "RX Descriptor Count"
	range 16 1024
	default 256
	depends on ETH_ENABLED
	help
	  Number of receive DMA descriptors.

config ETH_TX_DESCRIPTORS
	int "TX Descriptor Count"
	range 16 1024
	default 256
	depends on ETH_ENABLED
	help
	  Number of transmit DMA descriptors.

endmenu

menu "Timer Configuration"

config TIMER_ENABLED
	bool "Enable Generic Timer Driver"
	default y
	help
	  Enable the ARM Generic Timer driver.

config TIMER_IRQ
	int "Timer IRQ Number"
	default 27
	depends on TIMER_ENABLED
	help
	  IRQ number for the timer (typically PPI 27 for non-secure EL1).

endmenu

endmenu
```

## ARM64-RTOS/kernel/Kconfig
```kconfig
#
# Kernel Configuration
#

menu "Kernel Configuration"

config KERNEL_PREEMPTION
	bool "Enable Preemptive Scheduling"
	default y
	help
	  Enable preemptive multitasking. When disabled, tasks must
	  explicitly yield the CPU.

config KERNEL_TIMESLICE
	int "Time Slice (ticks)"
	range 1 100
	default 10
	depends on KERNEL_PREEMPTION
	help
	  Time slice for round-robin scheduling among same-priority tasks.

config KERNEL_STATS
	bool "Enable Kernel Statistics"
	default n
	help
	  Collect runtime statistics (CPU usage, context switches, etc.).

config KERNEL_STACK_CHECK
	bool "Enable Stack Overflow Detection"
	default y
	help
	  Check for stack overflows at context switch time.

config KERNEL_IDLE_SLEEP
	bool "Enter Low-Power Mode When Idle"
	default y
	help
	  Use WFI instruction in idle task to save power.

endmenu
```

## X86_64-RTOS/Kconfig
```kconfig
#
# Gracemont X86_64 RTOS Configuration
#

mainmenu "Gracemont X86_64 RTOS Configuration"

config GRACEMONT_RTOS
    bool
    default y

# ============================================================================
# Boot Configuration
# ============================================================================

menu "Boot Configuration"

choice
    prompt "Boot Method"
    default BOOT_MULTIBOOT2

config BOOT_MULTIBOOT2
    bool "Multiboot2 (GRUB/QEMU)"
    help
      Use Multiboot2 specification for booting.
      Compatible with GRUB2 and QEMU -kernel option.

config BOOT_UEFI
    bool "UEFI"
    help
      Boot as a UEFI application.
      Requires FAT filesystem image.

endchoice

config BOOT_CMDLINE
    string "Default kernel command line"
    default ""
    help
      Default command line arguments passed to the kernel.

endmenu

# ============================================================================
# System Configuration
# ============================================================================

menu "System Configuration"

config CPU_FREQ_HZ
    int "CPU frequency (Hz)"
    default 1000000000
    help
      Target CPU frequency in Hz. Used for timing calculations.

config TICK_RATE_HZ
    int "System tick rate (Hz)"
    range 100 10000
    default 1000
    help
      Number of system ticks per second.
      Higher values provide better timing resolution but more overhead.

config MAX_TASKS
    int "Maximum number of tasks"
    range 4 256
    default 32
    help
      Maximum number of concurrent tasks supported.

config MAX_PRIORITY
    int "Number of priority levels"
    range 4 256
    default 16
    help
      Number of task priority levels (0 = highest priority).

config TASK_STACK_SIZE
    int "Default task stack size (bytes)"
    range 1024 65536
    default 4096
    help
      Default stack size allocated for each task.

endmenu

# ============================================================================
# Memory Configuration
# ============================================================================

menu "Memory Configuration"

config HEAP_SIZE
    int "Heap size (bytes)"
    default 16777216
    help
      Size of the kernel heap in bytes (default: 16MB).

config DMA_POOL_SIZE
    int "DMA pool size (bytes)"
    default 4194304
    help
      Size of the DMA-safe memory pool in bytes (default: 4MB).

config ZBUF_POOL_SIZE
    int "Zero-copy buffer pool size (bytes)"
    default 2097152
    help
      Size of the zero-copy network buffer pool (default: 2MB).

config ZBUF_COUNT
    int "Number of zero-copy buffers"
    range 64 8192
    default 1024
    help
      Number of pre-allocated zero-copy buffers.

config ZBUF_SIZE
    int "Zero-copy buffer size (bytes)"
    range 256 65536
    default 2048
    help
      Size of each zero-copy buffer (should be >= MTU + headers).

config ZBUF_HEADROOM
    int "Zero-copy buffer headroom (bytes)"
    range 64 512
    default 128
    help
      Reserved space at the beginning of each buffer for headers.

endmenu

# ============================================================================
# Kernel Configuration
# ============================================================================

source "kernel/Kconfig"

# ============================================================================
# X86_64 Architecture Configuration
# ============================================================================

source "arch/x86_64/Kconfig"

# ============================================================================
# Driver Configuration
# ============================================================================

source "drivers/Kconfig"

# ============================================================================
# Network Configuration
# ============================================================================

source "net/Kconfig"

# ============================================================================
# Industrial Protocol Configuration
# ============================================================================

source "protocols/Kconfig"

# ============================================================================
# Debug Configuration
# ============================================================================

menu "Debug Configuration"

config DEBUG_LEVEL
    int "Debug output level"
    range 0 4
    default 2
    help
      0 = None, 1 = Error, 2 = Warning, 3 = Info, 4 = Debug

config DEBUG_SERIAL
    bool "Enable serial debug output"
    default y
    help
      Output debug messages to serial port.

config DEBUG_SERIAL_PORT
    hex "Serial port base address"
    depends on DEBUG_SERIAL
    default 0x3F8
    help
      Serial port base address (0x3F8 = COM1, 0x2F8 = COM2).

config DEBUG_SERIAL_BAUD
    int "Serial port baud rate"
    depends on DEBUG_SERIAL
    default 115200
    help
      Serial port baud rate.

config KERNEL_STATS
    bool "Enable kernel statistics"
    default n
    help
      Track and report kernel performance statistics.

config STACK_CANARY
    bool "Enable stack canary protection"
    default y
    help
      Add stack canaries to detect stack buffer overflows.

endmenu
```
